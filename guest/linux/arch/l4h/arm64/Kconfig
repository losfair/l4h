## guest/linux/arch/l4h/arm64/Kconfig
```kconfig
# SPDX-License-Identifier: GPL-2.0
config UML_ARM64
	def_bool $(success,test "$(SUBARCH)" = "aarch64")

if UML_ARM64
config 64BIT
	def_bool y
config ARM64
	def_bool y
	select CLONE_BACKWARDS
	select GENERIC_CPU_AUTOPROBE
	select HAVE_EFFICIENT_UNALIGNED_ACCESS
	select ARCH_WANT_DEFAULT_BPF_JIT
	select HAVE_EBPF_JIT
	select HAVE_MOD_ARCH_SPECIFIC
	select MODULES_USE_ELF_RELA
config KERNEL_MODE_NEON
	def_bool y
	help
	  Kernel-mode NEON (kernel_neon_begin/end, arch/l4h/arm64/neon.c)
	  works in the guest kernel, so the arm64 crypto algorithms in
	  arch/arm64/crypto (ARMv8 Crypto Extensions AES and others) can be
	  selected.
config ARM64_LSE_ATOMICS
	def_bool y
	help
	  Build the ARMv8.1 LSE atomics encoders and emitter of the BPF JIT
	  (arch/arm64/lib/insn.c, arch/arm64/net), which it uses when the CPU
	  has them (HWCAP_ATOMICS, cpus_have_cap()).  The guest kernel's own
	  atomics (arch/l4h/arm64/asm/atomic.h) do not use this option.
config GENERIC_HWEIGHT
	def_bool y
config GENERIC_CSUM
	def_bool y

source "arch/l4h/kvm/arm64/Kconfig"
endif
```

## guest/linux/arch/l4h/kvm/arm64/Kconfig
```kconfig
# SPDX-License-Identifier: GPL-2.0
#
# KVM in the AArch64 l4h guest kernel: arch/arm64/kvm's common code with a
# backend on FL4's EL2 VCPUs and Stage-2 VSpaces (arch/l4h/kvm/arm64).

source "virt/kvm/Kconfig"

config KVM
	bool "KVM on FL4 VCPUs"
	default y
	select KVM_ARM64
	help
	  Provide /dev/kvm where FL4 runs at EL2 (VHE) and hands out Stage-2
	  roots, for QEMU, Firecracker and cloud-hypervisor.  A kernel with
	  this option boots everywhere: /dev/kvm only appears when the host
	  hands out Stage-2 roots (bootinfo.nr_ept_roots).

config KVM_ARM64
	bool
	select KVM_COMMON
	select KVM_GENERIC_HARDWARE_ENABLING
	select KVM_GENERIC_MMU_NOTIFIER
	select KVM_MMIO
	select KVM_GENERIC_DIRTYLOG_READ_PROTECT
	select VIRT_XFER_TO_GUEST_WORK
	select HAVE_KVM_MSI
	select HAVE_KVM_DIRTY_RING_ACQ_REL
	select NEED_KVM_DIRTY_RING_WITH_BITMAP
	select HAVE_KVM_IRQCHIP
	select HAVE_KVM_IRQ_ROUTING
	select HAVE_KVM_READONLY_MEM
	select HAVE_KVM_VCPU_RUN_PID_CHANGE
	select SCHED_INFO
	select VHOST_TASK
```
