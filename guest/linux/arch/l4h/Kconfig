## guest/linux/arch/l4h/kvm/Kconfig
```kconfig
# SPDX-License-Identifier: GPL-2.0
#
# KVM in the l4h guest kernel: arch/x86/kvm's common code with a backend
# on seL4 VCPUs (arch/l4h/kvm).  See DESIGN.md §5.10.

source "virt/kvm/Kconfig"

config KVM
	bool "KVM on seL4 VCPUs"
	default y
	depends on !UML_ARM64
	select KVM_X86
	help
	  Provide /dev/kvm on hosts whose CPU has VT-x, for QEMU, Firecracker
	  and cloud-hypervisor.  A kernel with this option boots everywhere:
	  /dev/kvm only appears when the host hands out EPT roots.

config KVM_X86
	bool
	select KVM_COMMON
	select KVM_GENERIC_MMU_NOTIFIER
	select HAVE_KVM_IRQCHIP
	select HAVE_KVM_PFNCACHE
	select HAVE_KVM_DIRTY_RING_TSO
	select HAVE_KVM_DIRTY_RING_ACQ_REL
	select HAVE_KVM_IRQ_ROUTING
	select HAVE_KVM_IRQ_BYPASS
	select HAVE_KVM_READONLY_MEM
	select KVM_MMIO
	select SCHED_INFO
	select HAVE_KVM_MSI
	select HAVE_KVM_CPU_RELAX_INTERCEPT
	select HAVE_KVM_NO_POLL
	select KVM_GENERIC_DIRTYLOG_READ_PROTECT
	select KVM_GENERIC_HARDWARE_ENABLING
	select KVM_GENERIC_PRE_FAULT_MEMORY
	select VIRT_XFER_TO_GUEST_WORK
	select KVM_ASYNC_PF
	select VHOST_TASK

config KVM_IOAPIC
	def_bool KVM

config KVM_MAX_NR_VCPUS
	int
	default 64

config X86_LOCAL_APIC
	def_bool KVM
```

## guest/linux/arch/l4h/x86/Kconfig
```kconfig
if !UML_ARM64
# SPDX-License-Identifier: GPL-2.0

menu "Host processor type and features"

source "arch/x86/Kconfig.cpu"

endmenu

config UML_X86
	def_bool y
	select HAVE_KEMU
	select HAVE_RUST
	select DCACHE_WORD_ACCESS
	select GENERIC_GETTIMEOFDAY
	select GENERIC_TIME_VSYSCALL
	select HAVE_GENERIC_VDSO
	select HAVE_EFFICIENT_UNALIGNED_ACCESS
	select ARCH_WANT_DEFAULT_BPF_JIT
	select HAVE_EBPF_JIT

config 64BIT
	def_bool y

config L4H_X86_SIMD
	def_bool y
	help
	  Kernel-mode SIMD (kernel_fpu_begin/end, arch/l4h/x86/fpu.c) works
	  in the guest kernel, so the x86 crypto algorithms in
	  arch/x86/crypto (AES-NI and others) can be selected.

config X86_64
	def_bool y
	select MODULES_USE_ELF_RELA

config ARCH_HAS_SC_SIGNALS
	def_bool n

config ARCH_REUSE_HOST_VSYSCALL_AREA
	def_bool n

config GENERIC_HWEIGHT
	def_bool y

source "arch/l4h/kvm/Kconfig"

endif
```
